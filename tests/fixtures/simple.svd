# SimpleDevice register map
File version: 1.0
Simple test device
Registers are 32-bit, read-write, reset 0x0 unless marked. A register's access mark holds for its fields unless they carry their own. Offsets are from the block's base; lines under a group give offsets from that group; [hi:lo] are bit positions; {n}, {i} and the like mark numbered series; 'fields as' and 'values as' point back to an identical list; <NAME> marks a mode.

## Memory map
0x40010000 TIMER0 size 0x100 — Simple Timer

## TIMER0 — Simple Timer
Base 0x40010000
0x00 CR — Control Register
  [0] EN — Enable
0x04 COUNT — Counter Register
